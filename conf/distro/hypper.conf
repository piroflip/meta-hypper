## conf/distro/hypper.conf
```bitbake
#@--------------------------------------------------------------------
#@TYPE: Distribution
#@NAME: Hypper
#@DESCRIPTION: The Linux Distribution
#@MAINTAINER: Alexander Kotov <kot@ya.ru>
#@--------------------------------------------------------------------

# This is a aimed to be the next stable hypper release.
# If you want something stable *right now*, use hypper-v2013.12
#
# Use this at your own risk, we welcome bugreports sent to
#    hypper-distro-devel@linuxtogo.org
#
# For more contact info please visit
#    http://www.hypper-distribution.org/contact
#
# Again, in doubt, use the master branch of setup-scripts

# Preserve original DISTRO value
USERDISTRO := "${DISTRO}"
DISTRO = "hypper"
DISTRO_NAME = "HyPPer"

BUILDNAME = "HyPPer ${DISTRO_VERSION}"

TARGET_VENDOR = "-hypper"
SDK_VENDOR = "-hyppersdk"

DISTRO_VERSION = "next"

require conf/distro/include/sane-srcdates.inc
require conf/distro/include/sane-srcrevs.inc
require conf/distro/include/hypper-preferred-versions.inc

#Images built can have to modes:
# 'debug': empty rootpassword, strace included
# 'release' no root password, no strace and gdb by default
DISTRO_TYPE ?= "debug"
#DISTRO_TYPE = "release"

# Set the toolchain type (internal, external) and brand (generic, csl etc.)
TOOLCHAIN_TYPE ?= "internal"
TOOLCHAIN_BRAND ?= ""

# Ship just basic locale by default. Locales are big (~1Mb uncompr.), so
# shipping some adhoc subset will be still useless and size burden for
# users of all other languages/countries. Instead, worth to make it easy
# to install additional languages: installer/wizard + metapackages which
# will RRECOMMEND as much as possible content for a given language
# (locales, UI transalations, help, etc. - useless for pros, but really
# helpful for common users).
# Also, it appears that no locales fit in 16Mb for now. "C" locale rules!
ROOT_FLASH_SIZE ??= "32"
IMAGE_LINGUAS ?= '${@oe.utils.less_or_equal("ROOT_FLASH_SIZE", "16", "", "en-us", d)}'

#Everybody else can just use this:
HYPPER_GCC_VERSION                             ?= "7.%"
HYPPER_BINUTILS_VERSION                        ?= "2.31%"
HYPPER_GDB_VERSION                             ?= "8.%"

PREFERRED_VERSION_cross-localedef-native         ?= "2.2%"

HYPPER_QEMU_VERSION                            ?= "3%"

GCCVERSION                                       = "${HYPPER_GCC_VERSION}"
BINUVERSION                                      = "${HYPPER_BINUTILS_VERSION}"
GDBVERSION                                       = "${HYPPER_GDB_VERSION}"
PREFERRED_VERSION_qemu                           = "${HYPPER_QEMU_VERSION}"
PREFERRED_VERSION_qemu-native                    = "${HYPPER_QEMU_VERSION}"
PREFERRED_VERSION_nativesdk-qemu                 = "${HYPPER_QEMU_VERSION}"

PREFERRED_PROVIDER_dbus-glib                     = "dbus-glib"
PREFERRED_PROVIDER-gconf-dbus                    = "gconf"
PREFERRED_PROVIDER_hotplug                       = "systemd"
PREFERRED_PROVIDER_opkg                          ?= "opkg"
PREFERRED_PROVIDER_opkg-native                   ?= "opkg-native"

# Prefer systemd-boot over grub
EFI_PROVIDER                                     = "systemd-boot"

# blacklist policy

PNBLACKLIST[pn-fso-apm]       = "regular apmd is good enough"
PNBLACKLIST[gconf-dbus]        = "gconf-dbus has been merged back into main GConf"
PNBLACKLIST[gconf-dbus-native] = "gconf-dbus has been merged back into main GConf"

# Define splash before it gets set to empty in hypper-core-tweaks.inc:
SPLASH ?= ' ${@bb.utils.contains("MACHINE_FEATURES", "screen", "dietsplash", "",d)}'
require conf/distro/include/hypper.inc

# Prefer openssh over dropbear
TASK_BASIC_SSHDAEMON = "openssh-ssh openssh-sshd openssh-scp openssh-sftp openssh-sftp-server"

# Toolchain virtuals:
require conf/distro/include/toolchain-${TOOLCHAIN_TYPE}.inc
# Processor specific tunes like hard float ABI
include conf/distro/include/${TARGET_ARCH}-defaults.inc

# If we're using an .ipk based rootfs, we want to have opkg installed so postinst script can run
# We also take this opportunity to inject hypper-version into the rootfs
IPKG_VARIANT = "opkg hypper-version"

# do some packagegroup-base stuff here

# We want to ship extra debug utils in the rootfs when doing a debug build
DEBUG_APPS ?= ""
DEBUG_APPS += '${@oe.utils.conditional("DISTRO_TYPE", "release", "", "strace procps",d)}'

# This hooks into packagegroup-base, so it won't do anything if your images doesn't include packagegroup-base.
# hypper-version: ship this to have an identifiable rootfs so user can report bugs against a specific version
# util-linux-mount util-linux-umount: busybox mount is broken
# hypper-libc-fixup-hack: fixes an obscure bug with libc.so symlink
DISTRO_EXTRA_RDEPENDS += "\
    hypper-version \
    util-linux-mount util-linux-umount \
    hypper-libc-fixup-hack \
    "

# This also hooks into packagegroup-base, but isn't mandatory.
# If you don't want parts of this in your packagegroup-base using images you can put this in the image recipe:
# BAD_RECOMMENDATIONS = "avahi-daemon avahi-autoipd"
# Note that BAD_RECOMMENDATIONS is a feature of rootfs_ipk.bbclass, not hypper
# kernel modules: ship fs modules so you can mount stuff and af-packet so networking works
# avahi: makes finding your device on the network a lot easier
# openssh-sftp-server: provides sftp which combined with avahi makes it real easy to use things like sshfs
# psplash-hypper: hypper branded psplash, you can add your own psplash-foo to an image, it uses update-alternatives
# DEBUG_APPS: ship strace and procpc to make simple debugging a lot easier
DISTRO_EXTRA_RRECOMMENDS += " \
    kernel-module-vfat \
    kernel-module-ext2 \
    kernel-module-ext3 \
    kernel-module-af-packet \
    avahi-daemon \
    avahi-autoipd \
    openssh-sftp-server \
    ${DEBUG_APPS} \
"
VIRTUAL-RUNTIME_init_manager = "systemd"
# Uncomment to completely disable support for sysv scripts:
#PACKAGECONFIG_pn-systemd = "xz"

# Enable systemd support in kernels
KERNEL_ENABLE_CGROUPS = "1"

# USE-flag like features
# DISTRO_FEATURES += "tk"

# OpenGL support
# DISTRO_FEATURES += "opengl"

# Enable wayland
# DISTRO_FEATURES += "wayland"

# Inherit the default LIBC features superset from OE-core
DISTRO_FEATURES += "${DISTRO_FEATURES_LIBC}"
```

## conf/distro/include/hypper.inc
```bitbake
SOC_FAMILY ?= ""

# Yocto work around for missing ONLINE_PACKAGE_MANAGEMENT support
ONLINE_PACKAGE_MANAGEMENT = "full"

#Set the right arch for the feeds
#Alphabetically sorted

FEED_ARCH ?= "${TUNE_PKGARCH}"
TUNE_ARMPKGARCH = "${ARMPKGARCH}${ARMPKGSFX_DSP}${ARMPKGSFX_EABI}${ARMPKGSFX_ENDIAN}${ARMPKGSFX_FPU}"
FEED_ARCHS ?= "${TUNE_PKGARCH} ${TUNE_ARMPKGARCH}"

# Put links to sources in deploy/sources to make it easier for people to be GPL compliant
#INHERIT += "src_distribute_local"
SRC_DIST_LOCAL ?= "symlink"

# Can be "glibc", "musl" or "uclibc"
TCLIBC ?= "glibc"

# The things *libc can provide.
PREFERRED_PROVIDER_eglibc = "glibc"

PREFERRED_PROVIDER_virtual/gettext ??= "gettext"
PREFERRED_PROVIDER_linux-libc-headers-nativesdk = "linux-libc-headers-nativesdk"

require conf/distro/include/hypper-${TCLIBC}.inc

#Set the default maintainer to hypper-dev
MAINTAINER = ""

#use debian style naming
INHERIT += "debian"

#activate config checker
INHERIT += "sanity" 

#activate the blacklister
INHERIT += "blacklist"

#make devshell available as task
INHERIT += "devshell" 

#use hypper source mirrors to combat 404s
#INHERIT += "hypper-mirrors" 

#run QA tests on builds and packages and log them  
INHERIT += "insane"
QA_LOG = "1"

# Log information on images and packages
INHERIT += "buildhistory"
BUILDHISTORY_COMMIT = "1"

#run QA tests on recipes
#INHERIT += "recipe_sanity"

#have a shared state a.k.a package-staging2
INHERIT += "sstate"

HYPPER_PKG_FORMAT ?= "deb"
require conf/distro/include/hypper-package-${HYPPER_PKG_FORMAT}.inc

# MACHINE_KERNEL_PR if not defined can cause parsing failures
# since MACHINE_KERNEL_PR is used in PR assignments in some recipes
# (meta-ti comes to mind) which means when creating FILESPATH
# it will try to evaluate it and if its undefined then python
# will except
#
# so for machines which do not define it lets define it to be empty

MACHINE_KERNEL_PR ??= "r0"

#Generate locales on the buildsystem instead of on the target. Speeds up first boot, set to "1" to enable
PREFERRED_PROVIDER_qemu-native = "qemu-native"
ENABLE_BINARY_LOCALE_GENERATION ?= "1"

# We only want to build UTF8 locales
LOCALE_UTF8_ONLY = "1"

#qemu doesn't like this fp
ENABLE_BINARY_LOCALE_GENERATION_ep9312 = "0"

#qemu has taken a dislike to armeb as well
ENABLE_BINARY_LOCALE_GENERATION_armeb = "0"

# Prelink images
INHERIT += "image-prelink"

#Name the generated images in a sane way
IMAGE_NAME = "${DISTRO_NAME}-${IMAGE_BASENAME}-${TCLIBC}-${HYPPER_PKG_FORMAT}-${DISTRO_VERSION}-${MACHINE}"
DEPLOY_DIR_IMAGE = "${DEPLOY_DIR}/images/${MACHINE}"

# Prefer ext4 images where possible
SDIMG_ROOTFS_TYPE = "ext4"

# Hypper *always* has some form of release config, so error out if someone thinks he knows better 
DISTRO_CHECK := "${@d.getVar("DISTRO_VERSION",1) or bb.fatal('Remove this line or set a dummy DISTRO_VERSION if you really want to build an unversioned distro')}"

# We want images supporting the following features (for packagegroup(-core)-base)
DISTRO_FEATURES = "alsa argp bluetooth ext2 ipv4 ipv6 irda largefile nfs pam pci pcmcia ppp smbfs systemd usbgadget usbhost vfat wifi xattr zeroconf"

# Disable sysvinit for recipes with systemd or non-sysvinit support
DISTRO_FEATURES_BACKFILL_CONSIDERED += "sysvinit"

# EFL tweaks
include conf/distro/include/efl-from-svn.inc

# Yocto tweaks
require conf/distro/include/hypper-core-tweaks.inc
```
